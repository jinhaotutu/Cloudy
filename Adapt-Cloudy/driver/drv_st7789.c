// Adapt-Cloudy/driver/drv_st7789.c
// TFT ST7789 屏幕驱动实现
// 240×280，RGB565，4-wire SPI

#include "drv_st7789.h"
#include "hal_spi.h"
#include "hal_gpio.h"
#include "pin_config.h"
#include "esp_log.h"
#include "esp_rom_sys.h"
#include <string.h>

static const char *TAG = "drv_st7789";

// ASCII 8×16 点阵字模（0x20~0x7E，共 95 个字符）
static const uint8_t ascii_8x16[][16] = {
    {0x00,0x00,0x00,0x00,0x00,0x00,0x00,0x00,0x00,0x00,0x00,0x00,0x00,0x00,0x00,0x00}, // ' ' 0x20
    {0x00,0x00,0x18,0x3C,0x3C,0x3C,0x18,0x18,0x18,0x00,0x18,0x18,0x00,0x00,0x00,0x00}, // '!' 0x21
    {0x00,0x66,0x66,0x66,0x24,0x00,0x00,0x00,0x00,0x00,0x00,0x00,0x00,0x00,0x00,0x00}, // '"' 0x22
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    {0x00,0x00,0x76,0xDC,0x00,0x00,0x00,0x00,0x00,0x00,0x00,0x00,0x00,0x00,0x00,0x00}, // '~' 0x7E
};

static uint8_t s_line_buf[TFT_WIDTH * 2];

// ST7789 命令定义
#define ST7789_SWRESET   0x01
#define ST7789_SLPOUT    0x11
#define ST7789_NORON     0x13
#define ST7789_INVON     0x21
#define ST7789_DISPON    0x29
#define ST7789_CASET     0x2A
#define ST7789_RASET     0x2B
#define ST7789_RAMWR     0x2C
#define ST7789_MADCTL    0x36
#define ST7789_COLMOD    0x3A
#define ST7789_PORCTRL   0xB2
#define ST7789_GCTRL     0xB7
#define ST7789_VCOMS     0xBB
#define ST7789_LCMCTRL   0xC0
#define ST7789_VDVVRHEN  0xC2
#define ST7789_VRHS      0xC3
#define ST7789_VDVS      0xC4
#define ST7789_FRCTRL2   0xC6
#define ST7789_PWCTRL1   0xD0
#define ST7789_PVGAMCTRL 0xE0
#define ST7789_NVGAMCTRL 0xE1

#define ST7789_MADCTL_RGB 0x00

static void st7789_write_cmd(uint8_t cmd)
{
    hal_spi_send_cmd(cmd);
}

static void st7789_write_data(uint8_t data)
{
    hal_spi_send_data(data);
}

static void st7789_write_data16(uint16_t data)
{
    hal_spi_send_data16(data);
}

static void st7789_init_registers(void)
{
    // 软复位
    st7789_write_cmd(ST7789_SWRESET);
    esp_rom_delay_us(150000);

    // 退出睡眠
    st7789_write_cmd(ST7789_SLPOUT);
    esp_rom_delay_us(120000);

    // 列地址设置：0-239
    st7789_write_cmd(ST7789_CASET);
    st7789_write_data16(0x0000);
    st7789_write_data16(0x00EF);

    // 行地址设置：0-319（偏移 20）
    st7789_write_cmd(ST7789_RASET);
    st7789_write_data16(0x0014);
    st7789_write_data16(0x0153);

    // Porch Control
    st7789_write_cmd(ST7789_PORCTRL);
    st7789_write_data(0x0C);
    st7789_write_data(0x0C);
    st7789_write_data(0x00);
    st7789_write_data(0x33);
    st7789_write_data(0x33);

    // Gate Control
    st7789_write_cmd(ST7789_GCTRL);
    st7789_write_data(0x56);

    // VCOM Setting
    st7789_write_cmd(ST7789_VCOMS);
    st7789_write_data(0x18);

    // LCM Control
    st7789_write_cmd(ST7789_LCMCTRL);
    st7789_write_data(0x2C);

    // VDV/VRH Enable
    st7789_write_cmd(ST7789_VDVVRHEN);
    st7789_write_data(0x01);

    // VRH Set
    st7789_write_cmd(ST7789_VRHS);
    st7789_write_data(0x1F);

    // VDV Set
    st7789_write_cmd(ST7789_VDVS);
    st7789_write_data(0x20);

    // Frame Rate Control: 60Hz
    st7789_write_cmd(ST7789_FRCTRL2);
    st7789_write_data(0x0F);

    // Power Control 1
    st7789_write_cmd(ST7789_PWCTRL1);
    st7789_write_data(0xA4);
    st7789_write_data(0xA1);

    // Positive Voltage Gamma Control
    st7789_write_cmd(ST7789_PVGAMCTRL);
    st7789_write_data(0xD0);
    st7789_write_data(0x0D);
    st7789_write_data(0x14);
    st7789_write_data(0x0B);
    st7789_write_data(0x0B);
    st7789_write_data(0x07);
    st7789_write_data(0x3A);
    st7789_write_data(0x44);
    st7789_write_data(0x50);
    st7789_write_data(0x08);
    st7789_write_data(0x13);
    st7789_write_data(0x13);
    st7789_write_data(0x2D);
    st7789_write_data(0x32);

    // Negative Voltage Gamma Control
    st7789_write_cmd(ST7789_NVGAMCTRL);
    st7789_write_data(0xD0);
    st7789_write_data(0x0D);
    st7789_write_data(0x14);
    st7789_write_data(0x0B);
    st7789_write_data(0x0B);
    st7789_write_data(0x07);
    st7789_write_data(0x3A);
    st7789_write_data(0x44);
    st7789_write_data(0x50);
    st7789_write_data(0x08);
    st7789_write_data(0x13);
    st7789_write_data(0x13);
    st7789_write_data(0x2D);
    st7789_write_data(0x32);

    // MADCTL: 正常方向
    st7789_write_cmd(ST7789_MADCTL);
    st7789_write_data(ST7789_MADCTL_RGB);

    // COLMOD: RGB565
    st7789_write_cmd(ST7789_COLMOD);
    st7789_write_data(0x55);

    // 颜色反转
    st7789_write_cmd(ST7789_INVON);

    // 正常显示模式
    st7789_write_cmd(ST7789_NORON);
    esp_rom_delay_us(10000);

    // 开显示
    st7789_write_cmd(ST7789_DISPON);
    esp_rom_delay_us(10000);
}

void drv_st7789_init(void)
{
    // 初始化 SPI 引脚（CS 常低）
    hal_spi_init(TFT_CS_GPIO, TFT_SCL_GPIO, TFT_SDA_GPIO, TFT_DC_GPIO);

    // RST 硬件复位
    hal_gpio_init(TFT_RST_GPIO, HAL_GPIO_DIR_OUTPUT, HAL_GPIO_PULL_NONE);
    hal_gpio_set_level(TFT_RST_GPIO, true);
    hal_gpio_set_level(TFT_RST_GPIO, false);
    esp_rom_delay_us(100000);
    hal_gpio_set_level(TFT_RST_GPIO, true);
    esp_rom_delay_us(120000);

    // 初始化寄存器
    st7789_init_registers();

    // 清屏为黑色
    drv_st7789_fill_screen(COLOR_BLACK);

    ESP_LOGI(TAG, "ST7789 init done");
}

void drv_st7789_set_window(uint16_t x0, uint16_t y0, uint16_t x1, uint16_t y1)
{
    // 列地址设置
    st7789_write_cmd(ST7789_CASET);
    st7789_write_data16(x0);
    st7789_write_data16(x1);

    // 行地址设置（起始行偏移 20）
    st7789_write_cmd(ST7789_RASET);
    st7789_write_data16(y0 + 20);
    st7789_write_data16(y1 + 20);

    // 准备写显存
    st7789_write_cmd(ST7789_RAMWR);
}

void drv_st7789_fill_screen(uint16_t color)
{
    drv_st7789_fill_rect(0, 0, TFT_WIDTH, TFT_HEIGHT, color);
}

void drv_st7789_fill_rect(uint16_t x, uint16_t y, uint16_t w, uint16_t h, uint16_t color)
{
    if (x >= TFT_WIDTH || y >= TFT_HEIGHT) return;
    if (x + w > TFT_WIDTH) w = TFT_WIDTH - x;
    if (y + h > TFT_HEIGHT) h = TFT_HEIGHT - y;

    drv_st7789_set_window(x, y, x + w - 1, y + h - 1);

    // 填充行缓冲区
    uint8_t hi = (color >> 8) & 0xFF;
    uint8_t lo = color & 0xFF;
    for (int i = 0; i < w; i++) {
        s_line_buf[i * 2] = hi;
        s_line_buf[i * 2 + 1] = lo;
    }

    // 逐行发送
    for (int row = 0; row < h; row++) {
        hal_spi_send_data_bulk(s_line_buf, w * 2);
    }
}

void drv_st7789_draw_pixel(uint16_t x, uint16_t y, uint16_t color)
{
    if (x >= TFT_WIDTH || y >= TFT_HEIGHT) return;

    drv_st7789_set_window(x, y, x, y);
    st7789_write_data16(color);
}

void drv_st7789_draw_char(uint16_t x, uint16_t y, char ch, uint16_t color, uint16_t bg)
{
    if (ch < 0x20 || ch > 0x7E) ch = '?';

    const uint8_t *glyph = ascii_8x16[ch - 0x20];

    // 一次设置 8×16 窗口
    drv_st7789_set_window(x, y, x + 7, y + 15);

    uint8_t color_hi = (color >> 8) & 0xFF;
    uint8_t color_lo = color & 0xFF;
    uint8_t bg_hi = (bg >> 8) & 0xFF;
    uint8_t bg_lo = bg & 0xFF;

    // 逐行批量写入像素数据
    for (int row = 0; row < 16; row++) {
        uint8_t line = glyph[row];
        for (int col = 0; col < 8; col++) {
            if (line & (0x80 >> col)) {
                hal_spi_send_data(color_hi);
                hal_spi_send_data(color_lo);
            } else {
                hal_spi_send_data(bg_hi);
                hal_spi_send_data(bg_lo);
            }
        }
    }
}

void drv_st7789_draw_string(uint16_t x, uint16_t y, const char *str, uint16_t color, uint16_t bg)
{
    while (*str) {
        drv_st7789_draw_char(x, y, *str, color, bg);
        x += 8;
        if (x + 8 > TFT_WIDTH) {
            x = 0;
            y += 16;
        }
        str++;
    }
}

void drv_st7789_draw_char_scaled(uint16_t x, uint16_t y, char ch, uint16_t color, uint16_t bg, uint8_t scale)
{
    if (ch < 0x20 || ch > 0x7E) ch = '?';
    if (scale < 1) scale = 1;

    const uint8_t *glyph = ascii_8x16[ch - 0x20];
    uint16_t cw = 8 * scale;
    uint16_t ch_h = 16 * scale;

    // 设置缩放后的窗口
    drv_st7789_set_window(x, y, x + cw - 1, y + ch_h - 1);

    uint8_t color_hi = (color >> 8) & 0xFF;
    uint8_t color_lo = color & 0xFF;
    uint8_t bg_hi = (bg >> 8) & 0xFF;
    uint8_t bg_lo = bg & 0xFF;

    // 逐行写入，每行像素放大 scale 倍
    for (int row = 0; row < 16; row++) {
        uint8_t line = glyph[row];
        // 每行重复 scale 次
        for (int rep = 0; rep < scale; rep++) {
            for (int col = 0; col < 8; col++) {
                uint8_t hi = (line & (0x80 >> col)) ? color_hi : bg_hi;
                uint8_t lo = (line & (0x80 >> col)) ? color_lo : bg_lo;
                // 每列像素重复 scale 次
                for (int s = 0; s < scale; s++) {
                    hal_spi_send_data(hi);
                    hal_spi_send_data(lo);
                }
            }
        }
    }
}

void drv_st7789_draw_string_scaled(uint16_t x, uint16_t y, const char *str, uint16_t color, uint16_t bg, uint8_t scale)
{
    while (*str) {
        drv_st7789_draw_char_scaled(x, y, *str, color, bg, scale);
        x += 8 * scale;
        if (x + 8 * scale > TFT_WIDTH) {
            x = 0;
            y += 16 * scale;
        }
        str++;
    }
}

void drv_st7789_draw_string_center(uint16_t y, const char *str, uint16_t color, uint16_t bg, uint8_t scale)
{
    uint16_t len = 0;
    const char *p = str;
    while (*p++) len++;

    uint16_t str_w = len * 8 * scale;
    uint16_t x = (TFT_WIDTH > str_w) ? (TFT_WIDTH - str_w) / 2 : 0;

    drv_st7789_draw_string_scaled(x, y, str, color, bg, scale);
}
